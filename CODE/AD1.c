/** ###################################################################
**     THIS COMPONENT MODULE IS GENERATED BY THE TOOL. DO NOT MODIFY IT.
**     Filename  : AD1.C
**     Project   : galaxy2012_V0_1
**     Processor : 56F8013VFAE
**     Component : ADC
**     Version   : Component 01.580, Driver 02.05, CPU db: 2.87.097
**     Compiler  : Metrowerks DSP C Compiler
**     Date/Time : 2012/6/26, 8:56
**     Abstract  :
**         This device "ADC" implements an A/D converter,
**         its control methods and interrupt/event handling procedure.
**     Settings  :
**         AD control register         : ADC_ADCR1   [61568]
**         AD control register         : ADC_ADCR2   [61569]
**         AD control register         : ADC_ADZCC   [61570]
**         AD control register         : ADC_ADLST1  [61571]
**         AD control register         : ADC_ADLST2  [61572]
**         AD control register         : ADC_ADSDIS  [61573]
**         AD control register         : ADC_ADSTAT  [61574]
**         AD control register         : ADC_ADLSTAT [61575]
**         AD control register         : ADC_ADZCSTAT [61576]
**         AD control register         : ADC_ADLLMT0 [61585]
**         AD control register         : ADC_ADLLMT1 [61586]
**         AD control register         : ADC_ADLLMT2 [61587]
**         AD control register         : ADC_ADLLMT3 [61588]
**         AD control register         : ADC_ADLLMT4 [61589]
**         AD control register         : ADC_ADLLMT5 [61590]
**         AD control register         : ADC_ADLLMT6 [61591]
**         AD control register         : ADC_ADLLMT7 [61592]
**         AD control register         : ADC_ADHLMT0 [61593]
**         AD control register         : ADC_ADHLMT1 [61594]
**         AD control register         : ADC_ADHLMT2 [61595]
**         AD control register         : ADC_ADHLMT3 [61596]
**         AD control register         : ADC_ADHLMT4 [61597]
**         AD control register         : ADC_ADHLMT5 [61598]
**         AD control register         : ADC_ADHLMT6 [61599]
**         AD control register         : ADC_ADHLMT7 [61600]
**         AD control register         : ADC_ADOFS0  [61601]
**         AD control register         : ADC_ADOFS1  [61602]
**         AD control register         : ADC_ADOFS2  [61603]
**         AD control register         : ADC_ADOFS3  [61604]
**         AD control register         : ADC_ADOFS4  [61605]
**         AD control register         : ADC_ADOFS5  [61606]
**         AD control register         : ADC_ADOFS6  [61607]
**         AD control register         : ADC_ADOFS7  [61608]
**         AD control register         : ADC_ADPOWER [61609]
**         AD control register         : ADC_CAL     [61610]
**         Interrupt name              : INT_ADCA_Complete
**         Priority                    : 1
**         User handling procedure     : AD1_OnEnd
**         Number of conversions       : 1
**         AD resolution               : 12-bit
**
**         Input pins
**
**              Port name              : GPIOC
**              Bit number (in port)   : 0
**              Bit mask of the port   : 1
**              Port data register     : GPIO_C_DR   [61729]
**              Port control register  : GPIO_C_DDR  [61730]
**              Port function register : GPIO_C_PER  [61731]
**
**              Port name              : GPIOC
**              Bit number (in port)   : 1
**              Bit mask of the port   : 2
**              Port data register     : GPIO_C_DR   [61729]
**              Port control register  : GPIO_C_DDR  [61730]
**              Port function register : GPIO_C_PER  [61731]
**
**              Port name              : GPIOC
**              Bit number (in port)   : 4
**              Bit mask of the port   : 16
**              Port data register     : GPIO_C_DR   [61729]
**              Port control register  : GPIO_C_DDR  [61730]
**              Port function register : GPIO_C_PER  [61731]
**
**              Port name              : GPIOC
**              Bit number (in port)   : 5
**              Bit mask of the port   : 32
**              Port data register     : GPIO_C_DR   [61729]
**              Port control register  : GPIO_C_DDR  [61730]
**              Port function register : GPIO_C_PER  [61731]
**
**              Port name              : GPIOC
**              Bit number (in port)   : 6
**              Bit mask of the port   : 64
**              Port data register     : GPIO_C_DR   [61729]
**              Port control register  : GPIO_C_DDR  [61730]
**              Port function register : GPIO_C_PER  [61731]
**
**         Initialization:
**              Conversion             : Enabled
**              Event                  : Enabled
**         High speed mode
**             Prescaler               : divide-by-6
**     Contents  :
**         Enable     - byte AD1_Enable(void);
**         Disable    - byte AD1_Disable(void);
**         Start      - byte AD1_Start(void);
**         Stop       - byte AD1_Stop(void);
**         Measure    - byte AD1_Measure(bool WaitForResult);
**         GetValue16 - byte AD1_GetValue16(word *Values);
**
**     Copyright : 1997 - 2009 Freescale Semiconductor, Inc. All Rights Reserved.
**     
**     http      : www.freescale.com
**     mail      : support@freescale.com
** ###################################################################*/

/* MODULE AD1. */

#include "Events.h"
#include "AD1.h"

#define IDLE            0              /* IDLE state           */
#define MEASURE         1              /* MESURE state         */
#define CONTINUOUS      2              /* CONTINUOUS state     */
#define SINGLE          3              /* SINGLE state         */

/*lint -esym(765,AD1_EnUser) Disable MISRA rule (23) checking for symbols (AD1_EnUser). */
bool AD1_EnUser;                       /* Enable/Disable device */
static bool OutFlg;                    /* Measurement finish flag */
/*lint -esym(765,AD1_ModeFlg) Disable MISRA rule (23) checking for symbols (AD1_ModeFlg). */
volatile byte AD1_ModeFlg;             /* Current state of device */

/*
** ===================================================================
**     Method      :  AD1_InterruptCC (component ADC)
**
**     Description :
**         The method services the conversion complete interrupt of the 
**         selected peripheral(s) and eventually invokes the beans 
**         event(s).
**         This method is internal. It is used by Processor Expert only.
** ===================================================================
*/
#pragma interrupt alignsp saveall
void AD1_InterruptCC(void)
{
  setRegBits(ADC_ADSTAT,2048);         /* Clear EOSI flag */
  OutFlg = TRUE;                       /* Measured values are available */
  if (AD1_ModeFlg == CONTINUOUS) {     /* Running in continuous mode? */
    setRegBit(ADC_ADCR1,START0);       /* Launching of conversion */
  }
  else {
    AD1_ModeFlg = IDLE;                /* Set the bean to the idle mode */
  }
  AD1_OnEnd();                         /* If yes then invoke user event */
}

/*
** ===================================================================
**     Method      :  HWEnDi (component ADC)
**
**     Description :
**         Enables or disables the peripheral(s) associated with the bean.
**         The method is called automatically as a part of Enable, 
**         Disable and Init methods and several internal methods.
**         This method is internal. It is used by Processor Expert only.
** ===================================================================
*/
static void HWEnDi(void)
{
  volatile word i;

  if (AD1_EnUser) {                    /* Enable device? */
    if (getRegBits(ADC_ADPOWER,ADC_ADPOWER_PSTS_MASK)) { /* Is device enabled? */
      /* ADC_ADPOWER: ASB=0,??=0,??=0,PSTS2=0,PSTS1=0,PSTS0=0,PUDELAY=13,APD=0,PD2=0,PD1=0,PD0=0 */
      setReg(ADC_ADPOWER,208);         /* Enable device */
      for (i=0;i<100;i++) {}           /* Recovery time of voltage reference */
      while (ADC_ADPOWER&(ADC_ADPOWER_PSTS_MASK)) {} /* Wait for device powered up */
    }
    if (AD1_ModeFlg) {                 /* Launch measurement? */
      OutFlg = FALSE;                  /* Measured values are available */
      clrRegBit(ADC_ADCR1,STOP0);      /* Normal operation mode */
      setRegBit(ADC_ADCR1,START0);     /* Launching of conversion */
    }
    else {
      setRegBit(ADC_ADCR1,STOP0);      /* Stop command issued */
    }
  }
  else {
    setRegBit(ADC_ADCR1,STOP0);        /* Stop command issued */
    /* ADC_ADPOWER: ASB=0,??=0,??=0,PSTS2=0,PSTS1=0,PSTS0=0,PUDELAY=13,APD=0,PD2=1,PD1=1,PD0=1 */
    setReg(ADC_ADPOWER,215);           /* Disable device */
  }
}

/*
** ===================================================================
**     Method      :  AD1_Enable (component ADC)
**
**     Description :
**         Enables A/D converter bean. <Events> may be generated
**         (<DisableEvent>/<EnableEvent>). If possible, this method
**         switches on A/D converter device, voltage reference, etc.
**     Parameters  : None
**     Returns     :
**         ---             - Error code, possible codes:
**                           ERR_OK - OK
**                           ERR_SPEED - This device does not work in
**                           the active speed mode
** ===================================================================
*/
byte AD1_Enable(void)
{
  if (AD1_EnUser) {                    /* Is the device enabled by user? */
    return ERR_OK;                     /* If yes then set the flag "device enabled" */
  }
  AD1_EnUser = TRUE;                   /* Set the flag "device enabled" */
  HWEnDi();                            /* Enable the device */
  return ERR_OK;                       /* OK */
}

/*
** ===================================================================
**     Method      :  AD1_Disable (component ADC)
**
**     Description :
**         Disables A/D converter bean. No <events> will be generated.
**         If possible, this method switches off A/D converter device,
**         voltage reference, etc.
**     Parameters  : None
**     Returns     :
**         ---             - Error code, possible codes:
**                           ERR_OK - OK
**                           ERR_SPEED - This device does not work in
**                           the active speed mode
** ===================================================================
*/
byte AD1_Disable(void)
{
  if (!AD1_EnUser) {                   /* Is the device disabled by user? */
    return ERR_OK;                     /* If yes then OK */
  }
  AD1_EnUser = FALSE;                  /* If yes then set the flag "device disabled" */
  HWEnDi();                            /* Enable the device */
  return ERR_OK;                       /* OK */
}

/*
** ===================================================================
**     Method      :  AD1_Start (component ADC)
**
**     Description :
**         This method starts continuous conversion on all channels
**         that are set in the bean inspector. When each measurement on
**         all channels has finished the <OnEnd > event may be invoked.
**         This method is not available if the <interrupt service> is
**         disabled and the device doesn't support the continuous mode.
**         Note: If time of measurement is too short and the
**         instruction clock is too slow then the conversion complete
**         interrupt and its handler may cause a system overflow.
**     Parameters  : None
**     Returns     :
**         ---             - Error code, possible codes:
**                           ERR_OK - OK
**                           ERR_SPEED - This device does not work in
**                           the active speed mode
**                           ERR_DISABLED - Device is disabled
**                           ERR_BUSY - A conversion is already running
** ===================================================================
*/
byte AD1_Start(void)
{
  if (!AD1_EnUser) {                   /* Is the device disabled by user? */
    return ERR_DISABLED;               /* If yes then error */
  }
  if (AD1_ModeFlg != IDLE) {           /* Is the device in running mode? */
    return ERR_BUSY;                   /* If yes then error */
  }
  AD1_ModeFlg = CONTINUOUS;            /* Set state of device to the continuous mode */
  HWEnDi();                            /* Enable the device */
  return ERR_OK;                       /* OK */
}

/*
** ===================================================================
**     Method      :  AD1_Stop (component ADC)
**
**     Description :
**         This method stops the continuous measurement or disables
**         a trigger mode (if supported by HW), which has been
**         started by one of the following methods:
**         Version specific information for Freescale 56800
**         derivatives ] 
**         - <Start> 
**         - <EnableIntTrigger>
**         - <EnableIntChanTrigger>
**         The Stop method is available if one of the previously
**         mentioned methods is supported by A/D converter device
**         and is enabled to be generated.
**     Parameters  : None
**     Returns     :
**         ---             - Error code, possible codes:
**                           ERR_OK - OK
**                           ERR_SPEED - This device does not work in
**                           the active speed mode
**                           ERR_BUSY - No continuous measurement is
**                           running. Neither internal trigger nor
**                           external trigger have been enabled (if
**                           these are supported by HW).
** ===================================================================
*/
byte AD1_Stop(void)
{
  if (AD1_ModeFlg != CONTINUOUS) {     /* Is the device in different mode from "continuous"? */
    return ERR_BUSY;                   /* If yes then error */
  }
  setRegBit(ADC_ADCR1,STOP0);          /* Stop command issued */
  AD1_ModeFlg = IDLE;                  /* Set state of device to the stop mode */
  return ERR_OK;                       /* OK */
}

/*
** ===================================================================
**     Method      :  AD1_Measure (component ADC)
**
**     Description :
**         This method performs one measurement on all channels that
**         are set in the bean inspector. (Note: If the <number of
**         conversions> is more than one the conversion of A/D channels
**         is performed specified number of times.)
**     Parameters  :
**         NAME            - DESCRIPTION
**         WaitForResult   - Wait for a result of a
**                           conversion. If <interrupt service> is
**                           disabled, A/D peripheral doesn't support
**                           measuring all channels at once or Autoscan
**                           mode property isn't enabled and at the same
**                           time the <number of channel> is greater
**                           than 1, then the WaitForResult parameter is
**                           ignored and the method waits for each
**                           result every time. If the <interrupt
**                           service> is disabled and a <number of
**                           conversions> is greater than 1, the
**                           parameter is ignored and the method also
**                           waits for each result every time.
**     Returns     :
**         ---             - Error code, possible codes:
**                           ERR_OK - OK
**                           ERR_SPEED - This device does not work in
**                           the active speed mode
**                           ERR_DISABLED - Device is disabled
**                           ERR_BUSY - A conversion is already running
** ===================================================================
*/
byte AD1_Measure(bool WaitForResult)
{
  if (!AD1_EnUser) {                   /* Is the device disabled by user? */
    return ERR_DISABLED;               /* If yes then error */
  }
  if (AD1_ModeFlg != IDLE) {           /* Is the device in running mode? */
    return ERR_BUSY;                   /* If yes then error */
  }
  AD1_ModeFlg = MEASURE;               /* Set state of device to the measure mode */
  HWEnDi();                            /* Enable the device */
  if (WaitForResult) {                 /* Is WaitForResult TRUE? */
    while (AD1_ModeFlg == MEASURE) {}  /* If yes then wait for end of measurement */
  }
  return ERR_OK;                       /* OK */
}

/*
** ===================================================================
**     Method      :  AD1_GetValue16 (component ADC)
**
**     Description :
**         This method returns the last measured values of all channels
**         justified to the left. Compared with <GetValue> method this
**         method returns more accurate result if the <number of
**         conversions> is greater than 1 and <AD resolution> is less
**         than 16 bits. In addition, the user code dependency on <AD
**         resolution> is eliminated.
**     Parameters  :
**         NAME            - DESCRIPTION
**       * Values          - Pointer to the array that contains
**                           the measured data.
**     Returns     :
**         ---             - Error code, possible codes:
**                           ERR_OK - OK
**                           ERR_SPEED - This device does not work in
**                           the active speed mode
**                           ERR_NOTAVAIL - Requested value not
**                           available
**                           ERR_OVERRUN - External trigger overrun flag
**                           was detected after the last value(s) was
**                           obtained (for example by GetValue). This
**                           error may not be supported on some CPUs
**                           (see generated code).
** ===================================================================
*/
byte AD1_GetValue16(word *Values)
{
  if (!OutFlg) {                       /* Is measured value(s) available? */
    return ERR_NOTAVAIL;               /* If no then error */
  }
  *Values++ = (getReg(ADC_ADRSLT0) + 0) << 1; /* Store value from result register of device to user buffer */
  *Values++ = (getReg(ADC_ADRSLT1) + 0) << 1; /* Store value from result register of device to user buffer */
  *Values++ = (getReg(ADC_ADRSLT2) + 0) << 1; /* Store value from result register of device to user buffer */
  *Values++ = (getReg(ADC_ADRSLT3) + 0) << 1; /* Store value from result register of device to user buffer */
  *Values = (getReg(ADC_ADRSLT4) + 0) << 1; /* Store value from result register of device to user buffer */
  return ERR_OK;                       /* OK */
}

/*
** ===================================================================
**     Method      :  AD1_Init (component ADC)
**
**     Description :
**         Initializes the associated peripheral(s) and the beans 
**         internal variables. The method is called automatically as a 
**         part of the application initialization code.
**         This method is internal. It is used by Processor Expert only.
** ===================================================================
*/
void AD1_Init(void)
{
  AD1_EnUser = TRUE;                   /* Enable device */
  OutFlg = FALSE;                      /* No measured value */
  AD1_ModeFlg = IDLE;                  /* Device isn't running */
  /* ADC_ADCR1: ??=0,STOP0=1,START0=0,SYNC0=0,EOSIE0=1,ZCIE=0,LLMTIE=0,HLMTIE=0,CHNCFG=0,??=0,SMODE=0 */
  setReg(ADC_ADCR1,18432);             /* Set control register 1 */
  /* ADC_CAL: SEL_VREFH=0,SEL_VREFLO=0,??=0,??=0,??=0,??=0,??=0,??=0,??=0,??=0,??=0,??=0,??=0,??=0,??=0,??=0 */
  setReg(ADC_CAL,0);                   /* Set calibration register */
  /* ADC_ADOFS0: ??=0,OFFSET=0,??=0,??=0,??=0 */
  setReg(ADC_ADOFS0,0);                /* Set offset reg. 0 */
  /* ADC_ADOFS1: ??=0,OFFSET=0,??=0,??=0,??=0 */
  setReg(ADC_ADOFS1,0);                /* Set offset reg. 1 */
  /* ADC_ADOFS2: ??=0,OFFSET=0,??=0,??=0,??=0 */
  setReg(ADC_ADOFS2,0);                /* Set offset reg. 2 */
  /* ADC_ADOFS3: ??=0,OFFSET=0,??=0,??=0,??=0 */
  setReg(ADC_ADOFS3,0);                /* Set offset reg. 3 */
  /* ADC_ADOFS4: ??=0,OFFSET=0,??=0,??=0,??=0 */
  setReg(ADC_ADOFS4,0);                /* Set offset reg. 4 */
  /* ADC_ADHLMT0: ??=0,HLMT=4095,??=0,??=0,??=0 */
  setReg(ADC_ADHLMT0,32760);           /* Set high limit reg. 0 */
  /* ADC_ADHLMT1: ??=0,HLMT=4095,??=0,??=0,??=0 */
  setReg(ADC_ADHLMT1,32760);           /* Set high limit reg. 1 */
  /* ADC_ADHLMT2: ??=0,HLMT=4095,??=0,??=0,??=0 */
  setReg(ADC_ADHLMT2,32760);           /* Set high limit reg. 2 */
  /* ADC_ADHLMT3: ??=0,HLMT=4095,??=0,??=0,??=0 */
  setReg(ADC_ADHLMT3,32760);           /* Set high limit reg. 3 */
  /* ADC_ADHLMT4: ??=0,HLMT=4095,??=0,??=0,??=0 */
  setReg(ADC_ADHLMT4,32760);           /* Set high limit reg. 4 */
  /* ADC_ADLLMT0: ??=0,LLMT=0,??=0,??=0,??=0 */
  setReg(ADC_ADLLMT0,0);               /* Set low limit reg. 0 */
  /* ADC_ADLLMT1: ??=0,LLMT=0,??=0,??=0,??=0 */
  setReg(ADC_ADLLMT1,0);               /* Set low limit reg. 1 */
  /* ADC_ADLLMT2: ??=0,LLMT=0,??=0,??=0,??=0 */
  setReg(ADC_ADLLMT2,0);               /* Set low limit reg. 2 */
  /* ADC_ADLLMT3: ??=0,LLMT=0,??=0,??=0,??=0 */
  setReg(ADC_ADLLMT3,0);               /* Set low limit reg. 3 */
  /* ADC_ADLLMT4: ??=0,LLMT=0,??=0,??=0,??=0 */
  setReg(ADC_ADLLMT4,0);               /* Set low limit reg. 4 */
  /* ADC_ADZCSTAT: ??=1,??=1,??=1,??=1,??=1,??=1,??=1,??=1,ZCS7=1,ZCS6=1,ZCS5=1,ZCS4=1,ZCS3=1,ZCS2=1,ZCS1=1,ZCS0=1 */
  setReg(ADC_ADZCSTAT,65535);          /* Clear zero crossing status flags */
  /* ADC_ADLSTAT: HLS7=1,HLS6=1,HLS5=1,HLS4=1,HLS3=1,HLS2=1,HLS1=1,HLS0=1,LLS7=1,LLS6=1,LLS5=1,LLS4=1,LLS3=1,LLS2=1,LLS1=1,LLS0=1 */
  setReg(ADC_ADLSTAT,65535);           /* Clear high and low limit status */
  /* ADC_ADSTAT: CIP0=0,CIP1=0,??=0,EOSI1=0,EOSI0=1,ZCI=0,LLMTI=0,HLMTI=0,RDY7=0,RDY6=0,RDY5=0,RDY4=0,RDY3=0,RDY2=0,RDY1=0,RDY0=0 */
  setReg(ADC_ADSTAT,2048);             /* Clear EOSI flag */
  /* ADC_ADSDIS: ??=0,??=0,??=0,??=0,??=0,??=0,??=0,??=0,DS7=1,DS6=1,DS5=1,DS4=0,DS3=0,DS2=0,DS1=0,DS0=0 */
  setReg(ADC_ADSDIS,224);              /* Enable/disable of samples */
  /* ADC_ADLST1: ??=0,SAMPLE3=5,??=0,SAMPLE2=4,??=0,SAMPLE1=1,??=0,SAMPLE0=0 */
  setReg(ADC_ADLST1,21520);            /* Set ADC channel list reg. */
  /* ADC_ADLST2: ??=0,SAMPLE7=0,??=0,SAMPLE6=0,??=0,SAMPLE5=0,??=0,SAMPLE4=6 */
  setReg(ADC_ADLST2,6);                /* Set ADC channel list reg. */
  /* ADC_ADZCC: ZCE7=0,ZCE6=0,ZCE5=0,ZCE4=0,ZCE3=0,ZCE2=0,ZCE1=0,ZCE0=0 */
  setReg(ADC_ADZCC,0);                 /* Set zero crossing control reg. */
  /* ADC_ADCR2: ??=0,STOP1=0,START1=0,SYNC1=0,EOSIE1=0,??=0,??=0,??=0,??=0,??=0,SIMULT=1,DIV=2 */
  setReg(ADC_ADCR2,34);                /* Set prescaler */
  HWEnDi();                            /* Enable/disable device according to the status flags */
}

/* END AD1. */

/*
** ###################################################################
**
**     This file was created by Processor Expert 3.00 [04.35]
**     for the Freescale 56800 series of microcontrollers.
**
** ###################################################################
*/
